## boards/meppenSuedEngineering/board.yml
```yaml
board:
  name: pilsPlatine
  full_name: pilsPlatine
  vendor: meppenSouthEngineering
  socs:
  - name: nrf52832
```

## trichter-device/boards/meppenSuedEngineering/Kconfig.defconfig
```kconfig
if BOARD_PILSPLATINE
config BOARD
    default "pilsplatine"
endif

if BOARD_PILSPLATINE_BUTTONLESS
config BOARD
    default "pilsplatinebuttonless"
endif
```

## trichter-device/boards/meppenSuedEngineering/Kconfig.pilsPlatine
```kconfig
# EBYTE-TBB board configuration

# Copyright (c) 2021 Michal Morsisko
# SPDX-License-Identifier: Apache-2.0

config BOARD_PILSPLATINE
	bool "pilsPlatine NRF52832 (With buttons)"
	select SOC_NRF52832_QFAA

config BOARD_PILSPLATINE_NRF52832_BUTTONLESS
    bool "pilsPlatine NRF52832 (Buttonless)"
    select SOC_NRF52832_QFAA
    select BUTTONLESS

config BUTTONLESS
    bool
    help
      Hidden symbol selected automatically by the Buttonless board variant.
```

## trichter-device/boards/meppenSuedEngineering/board.yml
```yaml
board:
  name: pilsPlatine
  full_name: pilsPlatine
  vendor: meppenSouthEngineering
  socs:
  - name: nrf52832
    variants:
    - name: buttonless
```
